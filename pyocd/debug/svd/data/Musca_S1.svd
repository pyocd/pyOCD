# Musca_S1 register map
Vendor: ARM Ltd.; Series: ARMv8-M Mainline; File version: 1.0
ARM 32-bit v8-M Mainline based device
CPU: CM33 r0p1, little endian, MPU, no FPU, 3 interrupt priority bits, 8 SAU regions
Registers are 32-bit, read-write, reset 0x0 unless marked. A register's access mark holds for its fields unless they carry their own. Offsets are from the block's base; lines under a group give offsets from that group; [hi:lo] are bit positions; {n}, {i} and the like mark numbered series; 'fields as' and 'values as' point back to an identical list; <NAME> marks a mode.

## Memory map
0x40000000 TIMER0 size 0x10
0x40001000 TIMER1 size 0x10
0x40002000 DUALTIMER size 0x3C
0x4002E000 S32KWATCHDOG size 0xC04
0x4002F000 S32KTIMER size 0x10
0x40080000 NSPCTRL size 0x1000 — Non-secure Privilege Control Block
0x40081000 WATCHDOG size 0xC04 — Non-secure Watchdog Timer
0x40101000 UART0 size 0x4C
0x40102000 UART1 size 0x4C
0x40103000 SPI0 size 0xFC
0x40104000 I2C0 size 0xFC
0x40105000 I2C1 size 0xFC
0x40106000 I2S0 size 0xFC
0x4010A000 QSPIFCTRL size 0xB0 — QSPI Flash Controller
0x4010B000 GPTIMER size 0x20 — General-Purpose Timer
0x4010C800 SCC size 0x1000 — Serial Communication Controller
0x40110000 GPIO0 size 0x3C — General-purpose I/O 0
0x50000000 TIMER0_Secure size 0x10
0x50001000 TIMER1_Secure size 0x10
0x50002000 DUALTIMER_Secure size 0x3C
0x50021000 SYSCTRL size 0x1000 — System Control (Secure)
0x50022000 SYS_PPU size 0x1000 — SYS Power Policy Unit
0x50023000 CPU0CORE_PPU size 0x1000 — CPU0 Core Power Policy Unit
0x50024000 CPU0DBG_PPU size 0x1000 — CPU0 Debug Power Policy Unit
0x50025000 CPU1CORE_PPU size 0x1000 — CPU1 Core Power Policy Unit
0x50026000 CPU1DBG_PPU size 0x1000 — CPU1 Debug Power Policy Unit
0x50027000 CRYPTO_PPU size 0x1000 — Crypto Power Policy Unit
0x50029000 DBG_PPU size 0x1000 — Debug Power Policy Unit
0x5002A000 SRAM0_PPU size 0x1000 — SRAM0 Power Policy Unit
0x5002B000 SRAM1_PPU size 0x1000 — SRAM1 Power Policy Unit
0x5002C000 SRAM2_PPU size 0x1000 — SRAM2 Power Policy Unit
0x5002D000 SRAM3_PPU size 0x1000 — SRAM3 Power Policy Unit
0x5002E000 S32KWATCHDOG_Secure size 0xC04
0x5002F000 S32KTIMER_Secure size 0x10
0x50080000 SPCTRL size 0x1000 — Secure Privilege Control Block
0x50081000 WATCHDOG_Secure size 0xC04
0x50083000 SRAM0_MPC size 0x1000 — Memory Protection Controller 0
0x50084000 SRAM1_MPC size 0x1000 — SRAM 1 Memory Protection Controller
0x50085000 SRAM2_MPC size 0x1000 — SRAM 2 Memory Protection Controller
0x50086000 SRAM3_MPC size 0x1000 — SRAM 3 Memory Protection Controller
0x50101000 UART0_Secure size 0x4C
0x50102000 UART1_Secure size 0x4C
0x50103000 SPI0_Secure size 0xFC
0x50104000 I2C0_Secure size 0xFC
0x50105000 I2C1_Secure size 0xFC
0x50106000 I2S0_Secure size 0xFC
0x5010A000 QSPIFCTRL_Secure size 0xB0 — QSPI Flash Controller (Secure)
0x5010B000 GPTIMER_Secure size 0x20 — General-Purpose Timer (Secure)
0x5010C800 SCC_Secure size 0x1000 — Serial Communication Controller (Secure)
0x50110000 GPIO0_Secure size 0x3C — General-purpose I/O 0 (Secure)
0x50120000 QSPI_MPC size 0x1000 — QSPI Flash Memory Protection Controller
0x50130000 CODE_SRAM_MPC size 0x1000 — Code SRAM Memory Protection Controller
0xE000EDD0 SAU size 0x20 — Security Attribution Unit

## Interrupts
1 NONSEC_WATCHDOG (WATCHDOG) — Non-Secure Watchdog Interrupt
2 S32KTIMER — Timer 1
3 TIMER0
4 TIMER1
5 DUALTIMER
9 MPC (SRAM0_MPC) — MPC Combined
33 GPTIMER — General-Purpose Timer Interrupt
34 I2C_0 (I2C0) — I2C0 Interrupt
35 I2C_1 (I2C1) — I2C1 Interrupt
36 I2S_0 (I2S0) — I2S0 Interrupt
37 SPI_0 (SPI0) — SPI0 Interrupt
38 QSPI (QSPIFCTRL) — QSPI Interrupt
39 UART_0_RX (UART0) — UART0 Receive FIFO Interrupt
45 UART_1_RX (UART1) — UART1 Receive FIFO Interrupt
68 GPIO0 — GPIO 0 combined

## Licence text in the file
ARM Limited (ARM) is supplying this software for use with Cortex-M processor based microcontroller, but can be equally used for other suitable processor architectures. This file can be freely distributed. Modifications to this file shall be clearly marked. . THIS SOFTWARE IS PROVIDED "AS IS". NO WARRANTIES, WHETHER EXPRESS, IMPLIED. OR STATUTORY, INCLUDING, BUT NOT LIMITED TO, IMPLIED WARRANTIES OF. MERCHANTABILITY AND FITNESS FOR A PARTICULAR PURPOSE APPLY TO THIS SOFTWARE. ARM SHALL NOT, IN ANY CIRCUMSTANCES, BE LIABLE FOR SPECIAL, INCIDENTAL, OR. CONSEQUENTIAL DAMAGES, FOR ANY REASON WHATSOEVER.

## Notices in the file
Copyright (C) 2012-2019 Arm Limited. All rights reserved.
Purpose: System Viewer Description (SVD) Example (Schema Version 1.1)
This is a description of a none-existent and incomplete device
for demonstration purposes only.
Redistribution and use in source and binary forms, with or without
modification, are permitted provided that the following conditions are met:
- Redistributions of source code must retain the above copyright
notice, this list of conditions and the following disclaimer.
- Redistributions in binary form must reproduce the above copyright
notice, this list of conditions and the following disclaimer in the
documentation and/or other materials provided with the distribution.
- Neither the name of ARM nor the names of its contributors may be used
to endorse or promote products derived from this software without
specific prior written permission.
THIS SOFTWARE IS PROVIDED BY THE COPYRIGHT HOLDERS AND CONTRIBUTORS "AS IS"
AND ANY EXPRESS OR IMPLIED WARRANTIES, INCLUDING, BUT NOT LIMITED TO, THE
ARE DISCLAIMED. IN NO EVENT SHALL COPYRIGHT HOLDERS AND CONTRIBUTORS BE
LIABLE FOR ANY DIRECT, INDIRECT, INCIDENTAL, SPECIAL, EXEMPLARY, OR
CONSEQUENTIAL DAMAGES (INCLUDING, BUT NOT LIMITED TO, PROCUREMENT OF
SUBSTITUTE GOODS OR SERVICES; LOSS OF USE, DATA, OR PROFITS; OR BUSINESS
INTERRUPTION) HOWEVER CAUSED AND ON ANY THEORY OF LIABILITY, WHETHER IN
CONTRACT, STRICT LIABILITY, OR TORT (INCLUDING NEGLIGENCE OR OTHERWISE)
ARISING IN ANY WAY OUT OF THE USE OF THIS SOFTWARE, EVEN IF ADVISED OF THE
POSSIBILITY OF SUCH DAMAGE.
