# apollo3p register map
Vendor: Ambiq Micro; Series: Apollo; File version: 1.0
Ultra-Low power ARM Cortex-M4 MCU from Ambiq Micro
CPU: CM4 r1p0, little endian, MPU, FPU, I-cache, D-cache, VTOR, ITCM, DTCM, 3 interrupt priority bits, 0 interrupts
Registers are 32-bit, read-write, reset 0x0 unless marked. A register's access mark holds for its fields unless they carry their own. Offsets are from the block's base; lines under a group give offsets from that group; [hi:lo] are bit positions; {n}, {i} and the like mark numbered series; 'fields as' and 'values as' point back to an identical list; <NAME> marks a mode.

## Memory map
0x40000000 RSTGEN size 0xFFFF004 — MCU Reset Generator
0x40004000 CLKGEN size 0x110 — Clock Generator
0x40004200 RTC size 0x110 — Real Time Clock
0x40008000 CTIMER size 0x310 — Counter/Timer
0x4000C000 VCOMP size 0x210 — Voltage Comparator
0x40010000 GPIO size 0x254 — General Purpose IO
0x40011000 APBDMA size 0x44 — APB DMA Register Interfaces
0x40018000 CACHECTRL size 0x240 — FLASH Cache Controller
0x4001C000 UART0 size 0x48 — Serial UART
0x4001D000 UART1 size 0x48
0x40020000 MCUCTRL size 0x3DC — MCU Miscellaneous Control Logic
0x40021000 PWRCTRL size 0x30 — PWR Controller Register Bank
0x40024000 WDT size 0x210 — Watchdog Timer
0x40030000 SECURITY size 0x90 — Security Interfaces
0x40080000 SCARD size 0x104 — Serial ISO7816
0x50000000 IOSLAVE size 0x220 — I2C/SPI Slave
0x50004000 IOM0 size 0x414 — IO Peripheral Master
0x50005000 IOM1 size 0x414
0x50006000 IOM2 size 0x414
0x50007000 IOM3 size 0x414
0x50008000 IOM4 size 0x414
0x50009000 IOM5 size 0x414
0x5000C000 BLEIF size 0x414 — BLE Interface
0x50010000 ADC size 0x294 — Analog Digital Converter Control
0x50011000 PDM size 0x294 — PDM Audio
0x50014000 MSPI0 size 0x2C8 — Multi-bit SPI Master
0x50015000 MSPI1 size 0x2C8
0x50016000 MSPI2 size 0x2C8

## Interrupts
0 BROWNOUT (MCUCTRL) — BROWNOUT_IRQ
1 WDT — WDT_IRQ
2 RTC — RTC_IRQ
3 VCOMP — VCOMP_IRQ
4 IOSLAVE — IOSLAVE_IRQ
5 IOSLAVEACC (IOSLAVE) — IOSLAVEACC_IRQ
6 IOMSTR0 (IOM0) — IOMSTR0_IRQ
7 IOMSTR1 (IOM1) — IOMSTR1_IRQ
8 IOMSTR2 (IOM2) — IOMSTR2_IRQ
9 IOMSTR3 (IOM3) — IOMSTR3_IRQ
10 IOMSTR4 (IOM4) — IOMSTR4_IRQ
11 IOMSTR5 (IOM5) — IOMSTR5_IRQ
12 BLE (BLEIF) — BLE_IRQ
13 GPIO — GPIO_IRQ
14 CTIMER — CTIMER_IRQ
15 UART0 — UART0_IRQ
16 UART1 — UART1_IRQ
17 SCARD — SCARD_IRQ
18 ADC — ADC_IRQ
19 PDM — PDM_IRQ
20 MSPI0 — MSPI0_IRQ
22 STIMER (CTIMER) — STIMER_IRQ
{n+23} STIMER_CMPR{n} (CTIMER) (n=0..7) — STIMER_CMPR{n}_IRQ
31 CLKGEN — CLKGEN_IRQ
32 MSPI1 — MSPI1_IRQ
33 MSPI2 — MSPI2_IRQ
34 MAX (MSPI2) — Not a valid IRQ. The maximum IRQ is this value - 1.

## Licence text in the file
Copyright (c) 2023, Ambiq Micro, Inc. All rights reserved. . Redistribution and use in source and binary forms, with or without modification, are permitted provided that the following conditions are met: . 1. Redistributions of source code must retain the above copyright notice, this list of conditions and the following disclaimer. . 2. Redistributions in binary form must reproduce the above copyright notice, this list of conditions and the following disclaimer in the documentation and/or other materials provided with the distribution. . 3. Neither the name of the copyright holder nor the names of its contributors may be used to endorse or promote products derived from this software without specific prior written permission. . Third party software included in this distribution is subject to the additional license terms as defined in the /docs/licenses directory. . THIS SOFTWARE IS PROVIDED BY THE COPYRIGHT HOLDERS AND CONTRIBUTORS "AS IS" AND ANY EXPRESS OR IMPLIED WARRANTIES, INCLUDING, BUT NOT LIMITED TO, THE. IMPLIED WARRANTIES OF MERCHANTABILITY AND FITNESS FOR A PARTICULAR PURPOSE. ARE DISCLAIMED. IN NO EVENT SHALL THE COPYRIGHT HOLDER OR CONTRIBUTORS BE. LIABLE FOR ANY DIRECT, INDIRECT, INCIDENTAL, SPECIAL, EXEMPLARY, OR. CONSEQUENTIAL DAMAGES (INCLUDING, BUT NOT LIMITED TO, PROCUREMENT OF. SUBSTITUTE GOODS OR SERVICES; LOSS OF USE, DATA, OR PROFITS; OR BUSINESS. INTERRUPTION) HOWEVER CAUSED AND ON ANY THEORY OF LIABILITY, WHETHER IN. CONTRACT, STRICT LIABILITY, OR TORT (INCLUDING NEGLIGENCE OR OTHERWISE). ARISING IN ANY WAY OUT OF THE USE OF THIS SOFTWARE, EVEN IF ADVISED OF THE. POSSIBILITY OF SUCH DAMAGE.

## Notices in the file
Copyright (C) 2012-2014 ARM Limited. All rights reserved.
Purpose: System Viewer Description (SVD) Example (Schema Version 1.1)
This is a description of a none-existent and incomplete device
for demonstration purposes only.
- Neither the name of ARM nor the names of its contributors may be used
ARE DISCLAIMED. IN NO EVENT SHALL COPYRIGHT HOLDERS AND CONTRIBUTORS BE
