# MKW38A4 register map
Vendor: NXP Semiconductors; Series: Kinetis_W; File version: 1.6
MKW38A4 NXP Microcontroller
CPU: CM0PLUS r0p0, little endian, no MPU, no FPU, VTOR, 2 interrupt priority bits
Registers are 32-bit, read-write, no defined reset value unless marked. A register's access mark holds for its fields unless they carry their own. Offsets are from the block's base; lines under a group give offsets from that group; [hi:lo] are bit positions; {n}, {i} and the like mark numbered series; 'fields as' and 'values as' point back to an identical list; <NAME> marks a mode.

## Memory map
0x00000400 FTFE_FlashConfig size 0x10 — Flash configuration field
0x40008000 DMA0 size 0x1080 — DMA
0x4001F000 PFLEXNVM size 0x380 — FAC
0x40020000 FTFE size 0x30 — Flash Memory Interface
0x40021000 DMAMUX0 size 0x4 — DMAMUX
0x40024000 CAN0 size 0xC0C — CAN
0x40029000 TRNG0 size 0xF8
0x4002C000 SPI0 size 0x8C — Serial Peripheral Interface
0x4002D000 SPI1 size 0x8C — Serial Peripheral Interface
0x40037000 PIT size 0x120
0x40038000 TPM0 size 0x88 — Timer/PWM Module
0x40039000 TPM1 size 0x88 — Timer/PWM Module
0x4003A000 TPM2 size 0x88 — Timer/PWM Module
0x4003B000 ADC0 size 0x70 — Analog-to-Digital Converter
0x4003D000 RTC size 0x20 — Secure Real Time Clock
0x40040000 LPTMR0 size 0x10 — Low Power Timer
0x40041000 RFSYS size 0x20 — System register file
0x40047000 SIM size 0x1108 — System Integration Module
0x40049000 PORTA size 0xA4 — PORT
0x4004A000 PORTB size 0xA4 — PORT
0x4004B000 PORTC blocks up to offset 0xA4 — PORT
0x40054000 LPUART0 size 0x20 — Universal Asynchronous Receiver/Transmitter
0x40055000 LPUART1 size 0x20 — Universal Asynchronous Receiver/Transmitter
0x40058000 LTC0 size 0x7F4 — LTC
0x40059000 RSIM size 0x130
0x4005A000 DCDC size 0x20 — DC to DC Converter
0x4005B000 DSB size 0x18
0x40062000 CMT size 0xC — Carrier Modulator Transmitter
0x40064000 MCG size 0xE — Multipurpose Clock Generator module
0x40066000 I2C0 size 0xD — Inter-Integrated Circuit
0x40067000 I2C1 size 0xD — Inter-Integrated Circuit
0x40073000 CMP0 size 0x6 — High-Speed Comparator (CMP), Voltage Reference (VREF) Digital-to-Analog Converter (DAC), and Analog Mux (ANMUX)
0x40074000 VREF size 0x2 — Voltage Reference
0x4007C000 LLWU size 0xA — Low leakage wakeup unit
0x4007D000 PMC size 0x3 — Power Management Controller
0x4007E000 SMC size 0x4 — System Mode Controller
0x4007F000 RCM size 0x6 — Reset Control Module
0x40080000 BTLE_RF blocks up to offset 0x60A — Bluetooth LE RF
0x40082000 GENFSK size 0x100 — GENERIC FSK
0x40086000 RADIO_CTRL size 0x10 — RADIO_MISC
0x40086200 RBME size 0x70
0x40087000 XCVR_RX_DIG size 0x264
0x40087280 XCVR_MISC size 0xB0
0x40087380 XCVR_TSM size 0x12C
0x40087500 XCVR_ANALOG size 0x28
0x40087600 XCVR_PLL_DIG size 0x88
0x40087700 XCVR_TX_DIG size 0x60
0x40087800 XCVR_2P4GHZ_PHY size 0x118 — 2.4GHz PHY REGISTERS
0x40088000 TX_PACKET_RAM size 0x2800 — RADIO_PACKET_RAM
0x4008B000 RX_PACKET_RAM size 0x1D80 — RADIO_PACKET_RAM
0x400FF000 GPIOA size 0x18 — General Purpose Input/Output
0x400FF040 GPIOB size 0x18 — General Purpose Input/Output
0x400FF080 GPIOC size 0x18 — General Purpose Input/Output
0xE000E000 SystemControl blocks up to offset 0xD34 — System Control Block
0xE000E010 SysTick size 0x10 — System timer
0xE000E100 NVIC size 0x320 — Nested Vectored Interrupt Controller
0xF0000000 MTB size 0x1000 — Micro Trace Buffer
0xF0001000 MTBDWT size 0x1000 — MTB data watchpoint and trace
0xF0002000 ROM size 0x1000 — System ROM
0xF0003000 MCM blocks up to offset 0x44 — Core Platform Miscellaneous Control Module
0xF8000000 FGPIOA size 0x18 — General Purpose Input/Output
0xF8000040 FGPIOB size 0x18 — General Purpose Input/Output
0xF8000080 FGPIOC size 0x18 — General Purpose Input/Output

## Interrupts
5 FTFE
6 LVD_LVW_DCDC (DCDC, PMC)
7 LLWU
8 I2C0
9 I2C1
10 SPI0
12 LPUART0_LPUART1 (LPUART0, LPUART1)
13 TRNG0
14 CMT
15 ADC0
16 CMP0
17 TPM0
18 TPM1
19 TPM2
20 RTC
21 RTC_Seconds (RTC)
23 LTC0
27 MCG
28 LPTMR0
29 SPI1
30 PORTA (GPIOA)
31 PORTB_PORTC (GPIOB, GPIOC)

## Licence text in the file
Copyright 2016-2019 NXP. All rights reserved. SPDX-License-Identifier: BSD-3-Clause
