# HC32M413 register map
File version: 1.0
CPU: CM4 r0p1, little endian, MPU, FPU, 4 interrupt priority bits
Registers are 32-bit, read-write, reset 0x0 unless marked. A register's access mark holds for its fields unless they carry their own. Offsets are from the block's base; lines under a group give offsets from that group; [hi:lo] are bit positions; {n}, {i} and the like mark numbered series; 'fields as' and 'values as' point back to an identical list; <NAME> marks a mode.

## Memory map
0x00020000 ICG size 0x14
0x40010400 EFM size 0x289
0x40010800 AOS size 0x40
0x40015000 TMRA1 size 0x146 — desc TMRA
0x40015400 TMRA2 size 0x146 — desc TMRA
0x40015800 TMRA3 size 0x146 — desc TMRA
0x40015C00 TMRA4 size 0x146 — desc TMRA
0x40016000 TMRA5 size 0x182
0x40017000 TMR4 size 0x11E
0x40017C00 EMB0 size 0x1C — desc EMB
0x40017C20 EMB1 size 0x1C — desc EMB
0x4001C000 SPI size 0x1C
0x4001D000 USART1 size 0x1C — desc USART
0x4001D400 USART2 size 0x20 — desc USART
0x4001E800 HALL size 0x34
0x40021000 USART3 size 0x20 — desc USART
0x40021400 USART4 size 0x20 — desc USART
0x40024000 TMR01 size 0x18 — desc TMR0
0x40024400 TMR02 size 0x18 — desc TMR0
0x40030000 ADC size 0xC4
0x40048400 FCM size 0x24
0x40049000 WDT size 0xC
0x40049400 SWDT size 0xC
0x4004A000 CMP1 size 0x20 — desc CMP
0x4004A000 CMP_COMMON size 0x10
0x4004A100 CMP2 size 0x20 — desc CMP
0x4004A400 CMP3 size 0x20 — desc CMP
0x4004E000 I2C size 0x3C
0x40050400 CRC size 0x100
0x40051000 INTC size 0x2AC
0x40052000 DCU size 0x1C
0x40053000 DMA size 0x138
0x40053800 GPIO size 0x5CC
0x40054000 PWC size 0x54
0x40054100 RMU size 0x8
0x40054400 CMU size 0x49
0x40054800 MAU size 0x2C
0x40054C00 PERIC size 0x20
0xE0042000 DBGC size 0x40

## Interrupts
{n} GLOBAL{n}_SWINT{n} (INTC) (n=0..15) — global interrupt {n} or software interrupt {n}
{n+16} EXTINT{n}_SWINT{n+16} (INTC) (n=0..7) — external interrupt {n} or software interrupt {n+16}
24 DMA_Error (DMA) — DMA error interrupt
25 DMA_TC0_BTC0 (DMA) — DMA Transmission Complete 0 or Block Transmission Complete 0 interrupt
26 DMA_TC1_BTC1 (DMA) — DMA Transmission Complete 1 or Block Transmission Complete 1 interrupt
27 DMA_TC2_BTC2 (DMA) — DMA Transmission Complete 2 or Block Transmission Complete 2 interrupt
28 DMA_TC3_BTC3 (DMA) — DMA Transmission Complete 3 or Block Transmission Complete 3 interrupt
29 PEERR_RDCOL (EFM) — EFM program erase error or read column interrupt
30 OPTEND (EFM) — EFM Operation End interrupt
31 DCU — DCU interrupt
32 FPU_ERR (INTC) — FPU error interrupt
33 MAU — MAU interrupt
34 TMR0_1 (TMR01) — Timer0 unit 1 interrupt
35 TMR0_2 (TMR02) — Timer0 unit 2 interrupt
36 XTAL_STOP (CMU) — Xtal stop interrupt
37 SWDT — SWDT underflow or refresh error interrupt
38 TMRA_1_OVF_UDF (TMRA1) — TimerA unit 1 overflow or underflow interrupt
39 TMRA_1_CMP (TMRA1) — TimerA unit 1 compare matched interrupt
40 TMRA_2_OVF_UDF (TMRA2) — TimerA unit 2 overflow or underflow interrupt
41 TMRA_2_CMP (TMRA2) — TimerA unit 2 compare matched interrupt
42 TMRA_3_OVF_UDF (TMRA3) — TimerA unit 3 overflow or underflow interrupt
43 TMRA_3_CMP (TMRA3) — TimerA unit 3 compare matched interrupt
44 TMRA_4_OVF_UDF (TMRA4) — TimerA unit 4 overflow or underflow interrupt
45 TMRA_4_CMP (TMRA4) — TimerA unit 4 compare matched interrupt
46 EMB_GR0 (EMB0) — EMB Group0 interrupt
47 EMB_GR1 (EMB1) — EMB Group1 interrupt
48 TMR4_GCMP (TMR4) — Timer4 compare matched interrupt
49 TMR4_OVF_UDF (TMR4) — Timer4 overflow or underflow interrupt
50 TMR4_RELOAD (TMR4) — Timer4 reload matched interrupt
51 TMR4_SCM (TMR4) — Timer4 special compare matched interrupt
52 USART1 — USART unit 1 interrupt
53 USART1_TC (USART1) — USART unit 1 Transmission complete interrupt
54 SPI — SPI interrupt
55 TMRA_5_OVF_UDF (TMRA5) — TimerA unit 5 overflow or underflow interrupt
56 TMRA_5_CMP (TMRA5) — TimerA unit 5 compare matched interrupt
57 USART2 — USART unit 2 interrupt
58 USART2_TC (USART2) — USART unit 2 Transmission complete interrupt
59 USART3 — USART unit 3 interrupt
60 USART3_TC (USART3) — USART unit 3 Transmission complete interrupt
61 USART4 — USART unit 4 interrupt
62 USART4_TC (USART4) — USART unit 4 Transmission complete interrupt
63 HALL — HALL interrupt
64 CMP1 — CMP1 interrupt
65 CMP2 — CMP2 interrupt
66 CMP3 — CMP3 interrupt
67 I2C — I2C interrupt
68 USART1_WKUP (USART1) — USART unit 1 RX weak-up interrupt
69 LVD1 (PWC) — Low voltage detect unit 1 interrupt
70 LVD2 (PWC) — Low voltage detect unit 2 interrupt
71 FCM — Frequency measurement interrupt
72 WDT — WDT underflow or refresh error interrupt
73 ADC — ADC interrupt
