# MKE15Z7 register map
Vendor: Freescale Semiconductor, Inc.; Series: Kinetis_E; File version: 1.6
MKE15Z7 Freescale Microcontroller
CPU: CM0PLUS r0p0, little endian, no MPU, no FPU, VTOR, 2 interrupt priority bits
Registers are 32-bit, read-write, reset 0x0 unless marked. A register's access mark holds for its fields unless they carry their own. Offsets are from the block's base; lines under a group give offsets from that group; [hi:lo] are bit positions; {n}, {i} and the like mark numbered series; 'fields as' and 'values as' point back to an identical list; <NAME> marks a mode.

## Memory map
0x00000400 FTFE_FlashConfig size 0x10 — Flash configuration field
0x40000000 AIPS size 0x84 — AIPS-Lite Bridge
0x40008000 DMA size 0x1100 — Enhanced direct memory access controller
0x40020000 FTFE size 0x30 — Flash Memory Interface
0x40021000 DMAMUX size 0x8 — DMA channel multiplexor
0x40027000 ADC1 size 0xEC — Analog-to-Digital Converter
0x4002C000 LPSPI0 size 0x78 — The LPSPI Memory Map/Register Definition can be found here.
0x4002D000 LPSPI1 size 0x78 — The LPSPI Memory Map/Register Definition can be found here.
0x40032000 CRC size 0xC — Cyclic Redundancy Check
0x40036000 PDB0 size 0x19C — Programmable Delay Block
0x40037000 LPIT0 size 0x5C — Low Power Periodic Interrupt Timer (LPIT)
0x40038000 FTM0 size 0x224 — FlexTimer Module
0x40039000 FTM1 size 0x224 — FlexTimer Module
0x4003A000 FTM2 size 0x224 — FlexTimer Module
0x4003B000 ADC0 size 0xEC — Analog-to-Digital Converter
0x4003D000 RTC size 0x808 — Secure Real Time Clock
0x40040000 LPTMR0 size 0x10 — Low Power Timer
0x40045000 TSI size 0x28 — Touch sense input
0x40048000 SIM blocks up to offset 0x70 — System Integration Module
0x40049000 PORTA size 0xCC — Pin Control and Interrupts
0x4004A000 PORTB size 0xCC — Pin Control and Interrupts
0x4004B000 PORTC size 0xCC — Pin Control and Interrupts
0x4004C000 PORTD size 0xCC — Pin Control and Interrupts
0x4004D000 PORTE size 0xCC — Pin Control and Interrupts
0x40052000 WDOG size 0x10 — Watchdog timer
0x40056000 PWT size 0x8 — Pulse Width Timer
0x4005A000 FLEXIO size 0x510 — The FLEXIO Memory Map/Register Definition can be found here.
0x40060000 OSC32 size 0x1 — RTC Oscillator
0x40061000 EWM size 0x6 — External Watchdog Monitor
0x40062000 TRGMUX0 size 0x70 — TRGMUX
0x40063000 TRGMUX1 size 0x8 — TRGMUX
0x40064000 SCG size 0x518 — System Clock Generator
0x40065000 PCC blocks up to offset 0x1D4
0x40066000 LPI2C0 size 0x174 — The LPI2C Memory Map/Register Definition can be found here.
0x40067000 LPI2C1 size 0x174 — The LPI2C Memory Map/Register Definition can be found here.
0x4006A000 LPUART0 size 0x30 — LPUART
0x4006B000 LPUART1 size 0x30 — LPUART
0x4006C000 LPUART2 size 0x30 — LPUART
0x40073000 CMP0 size 0xC — High-Speed Comparator (CMP), Voltage Reference (VREF) Digital-to-Analog Converter (DAC), and Analog Mux (ANMUX)
0x40074000 CMP1 size 0xC — High-Speed Comparator (CMP), Voltage Reference (VREF) Digital-to-Analog Converter (DAC), and Analog Mux (ANMUX)
0x4007D000 PMC size 0x5
0x4007E000 SMC size 0x18 — System Mode Controller
0x4007F000 RCM size 0x20 — Reset Control Module
0x400FF000 GPIOA size 0x18 — General Purpose Input/Output
0x400FF040 GPIOB size 0x18 — General Purpose Input/Output
0x400FF080 GPIOC size 0x18 — General Purpose Input/Output
0x400FF0C0 GPIOD size 0x18 — General Purpose Input/Output
0x400FF100 GPIOE size 0x18 — General Purpose Input/Output
0xF0000000 MTB size 0x1000 — Micro Trace Buffer
0xF0001000 MTBDWT size 0x1000 — MTB data watchpoint and trace
0xF0002000 ROM size 0x1000 — System ROM
0xF0003000 MCM blocks up to offset 0x84 — Core Platform Miscellaneous Control Module
0xF0004000 MMDVSQ size 0x14 — Divide and Square Root

## Interrupts
0 DMA0_04 (DMA)
1 DMA0_15 (DMA)
2 DMA0_26 (DMA)
3 DMA0_37 (DMA)
4 DMA_Error (DMA)
5 FTFE
6 LVD_LVW (PMC)
7 PORTAE (PORTA, PORTE, GPIOA, GPIOE)
8 LPI2C0
9 LPI2C1
10 LPSPI0
11 LPSPI1
12 LPUART0
13 LPUART1
14 LPUART2
15 ADC0
16 CMP0
17 FTM0
18 FTM1
19 FTM2
20 RTC
21 CMP1
22 LPIT0
23 FLEXIO
24 TSI
25 PDB0
26 PORTBCD (PORTB, PORTC, PORTD, GPIOB, GPIOC, GPIOD)
27 SCG
28 WDOG_EWM (WDOG, EWM)
29 PWT_LPTMR0 (LPTMR0, PWT)
30 ADC1
31 RCM

## Licence text in the file
Redistribution and use in source and binary forms, with or without modification, are permitted provided that the following conditions are met: o Redistributions of source code must retain the above copyright notice, this list of conditions and the following disclaimer. o Redistributions in binary form must reproduce the above copyright notice, this list of conditions and the following disclaimer in the documentation and/or other materials provided with the distribution. o Neither the name of Freescale Semiconductor, Inc. nor the names of its contributors may be used to endorse or promote products derived from this software without specific prior written permission. THIS SOFTWARE IS PROVIDED BY THE COPYRIGHT HOLDERS AND CONTRIBUTORS "AS IS" AND. ANY EXPRESS OR IMPLIED WARRANTIES, INCLUDING, BUT NOT LIMITED TO, THE IMPLIED. WARRANTIES OF MERCHANTABILITY AND FITNESS FOR A PARTICULAR PURPOSE ARE. DISCLAIMED. IN NO EVENT SHALL THE COPYRIGHT HOLDER OR CONTRIBUTORS BE LIABLE FOR. ANY DIRECT, INDIRECT, INCIDENTAL, SPECIAL, EXEMPLARY, OR CONSEQUENTIAL DAMAGES (INCLUDING, BUT NOT LIMITED TO, PROCUREMENT OF SUBSTITUTE GOODS OR SERVICES; LOSS OF USE, DATA, OR PROFITS; OR BUSINESS INTERRUPTION) HOWEVER CAUSED AND ON. ANY THEORY OF LIABILITY, WHETHER IN CONTRACT, STRICT LIABILITY, OR TORT (INCLUDING NEGLIGENCE OR OTHERWISE) ARISING IN ANY WAY OUT OF THE USE OF THIS. SOFTWARE, EVEN IF ADVISED OF THE POSSIBILITY OF SUCH DAMAGE.
