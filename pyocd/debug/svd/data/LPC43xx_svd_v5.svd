# LPC43xx register map
File version: 5
Register cmsis file for LPC43xx parts
Registers are 32-bit, read-write, reset 0x0 unless marked. A register's access mark holds for its fields unless they carry their own. Offsets are from the block's base; lines under a group give offsets from that group; [hi:lo] are bit positions; {n}, {i} and the like mark numbered series; 'fields as' and 'values as' point back to an identical list; <NAME> marks a mode.

## Memory map
0x40000000 SCT size 0xFFF — Product name title=UM10430 Chapter title=LPC18xx State Configurable Timer (SCT) Modification date=1/18/2011 Major revision=0 Minor revision=7
0x40002000 GPDMA size 0xFFF — Product name title=UM10430 Chapter title=LPC18xx General Purpose DMA (GPDMA) controller Modification date=1/19/2011 Major revision=0 Minor revision=7
0x40004000 SDMMC size 0xFFF — Product name title=UM10430 Chapter title=LPC18xx SD/MMC Modification date=n/a Major revision=n/a Minor revision=n/a
0x40005000 EMC size 0xFFF — Product name title=UM10430 Chapter title=LPC18xx External Memory Controller (EMC) Modification date=1/19/2011 Major revision=0 Minor revision=7
0x40006000 USB0 size 0xFFF — Product name title=UM10430 Chapter title=LPC18xx USB0 Host/Device/OTG controller Modification date=1/19/2011 Major revision=0 Minor revision=7
0x40007000 USB1 size 0xFFF — Product name title=UM10430 Chapter title=LPC18xx USB1 Host/Device controller Modification date=1/19/2011 Major revision=0 Minor revision=7
0x40008000 LCD size 0xFFFF — Product name title=UM10430 Chapter title=LPC18xx LCD Modification date=1/19/2011 Major revision=0 Minor revision=7
0x40010000 ETHERNET size 0xFFFFF — Product name title=UM10430 Chapter title=LPC18xx Ethernet Modification date=12/9/2011 Major revision=1.1 Minor revision=not available
0x40040000 ATIMER size 0xFFFF — Product name title=UM10430 Chapter title=LPC18xx Alarm timer Modification date=1/7/2011 Major revision=0 Minor revision=6
0x40041000 REGFILE size 0xFFFF — Product name title=UM10430 Chapter title=LPC18xx rtc/REGFILE date=1/20/2011 Major revision=0 Minor revision=7
0x40042000 PMC size 0xFFFF — Product name title=UM10430 Chapter title=LPC18xx Power Management Controller (PMC) Modification date=1/20/2011 Major revision=0 Minor revision=7
0x40043000 CREG size 0xFFF — Product name title=UM10503 Chapter title=LPC43xx Configuration Registers (CREG) Modification date=10/7/2011 Major revision=0 Minor revision=3
0x40044000 EVENTROUTER size 0xFFF — Product name title=UM10503 Chapter title=LPC43xx Event router Modification date=10/7/2011 Major revision=0 Minor revision=3
0x40046000 RTC size 0xFFFF — Product name title=UM10430 Chapter title=LPC18xx Real-Time Clock (RTC) Modification date=1/20/2011 Major revision=0 Minor revision=7
0x40050000 CGU size 0xFFF — Product name title=UM10462 Chapter title=LPC18xx Clock Generation Unit (CGU) Modification date=6/1/2011 Major revision=0 Minor revision=1
0x40051000 CCU1 size 0xFFFF — Product name title=UM10430 Chapter title=LPC43xx Clock Control Unit (CCU)
0x40052000 CCU2 size 0xFFFF — Product name title=UM10430 Chapter title=LPC18xx Clock Control Unit (CCU) Modification date=1/21/2011 Major revision=0 Minor revision=7
0x40053000 RGU size 0xFFF — Product name title=UM10503 Chapter title=LPC43xx Reset Generation Unit (RGU) Modification date=7/20/2011 Major revision=0 Minor revision=13
0x40080000 WWDT size 0x300 — Product name title=UM10430 Chapter title=LPC18xx Windowed Watchdog timer (WWDT) Modification date=1/14/2011 Major revision=0 Minor revision=7
0x40081000 USART0 size 0x300 — Product name title=UM10430 Chapter title=LPC18xx USART0_2_3 Modification date=1/14/2011 Major revision=0 Minor revision=7
0x40082000 UART1 size 0x300 — Product name title=UM10430 Chapter title=LPC18xx UART1 Modification date=1/14/2011 Major revision=0 Minor revision=7
0x40083000 SSP0 size 0x300 — Product name title=UM10430 Chapter title=LPC18xx SSP0/1 Modification date=1/14/2011 Major revision=0 Minor revision=7
0x40084000 TIMER0 size 0x300 — Product name title=UM10430 Chapter title=LPC18xx Timer0/1/2/3 Modification date=1/14/2011 Major revision=0 Minor revision=7
0x40085000 TIMER1 size 0x300
0x40086000 SCU size 0xFFF — Product name title=UM10430 Chapter title=LPC18xx System Control Unit (SCU) Modification date=6/8/2011 Major revision=0 Minor revision=10
0x40087000 GPIO_PIN_INT size 0xFFF — GPIO pin interrupt
0x40088000 GPIO_GROUP_INT0 size 0xFFF — GPIO group interrupt 0
0x40089000 GPIO_GROUP_INT1 size 0xFFF
0x400A0000 MCPWM size 0xFFF — Product name title=UM10430 Chapter title=LPC18xx Motor Control PWM (MOTOCONPWM) Modification date=1/14/2011 Major revision=0 Minor revision=7
0x400A1000 I2C0 size 0xFFF — Product name title=UM10430 Chapter title=LPC18xx I2C-bus interface Modification date=1/14/2011 Major revision=0 Minor revision=7
0x400A2000 I2S0 size 0xFFF — Product name title=UM10430 Chapter title=LPC18xx I2S interface Modification date=1/14/2011 Major revision=0 Minor revision=7
0x400A3000 I2S1 size 0xFFF
0x400A4000 C_CAN1 size 0xFFF — Product name title=UM10430 Chapter title=LPC18xx C_CAN Modification date=1/18/2011 Major revision=0 Minor revision=7
0x400C0000 RITIMER size 0xFFF — Product name title=UM10430 Chapter title=LPC18xx Repetitive Interrupt Timer (RIT) Modification date=1/14/2011 Major revision=0 Minor revision=7
0x400C1000 USART2 size 0x300
0x400C2000 USART3 size 0x300
0x400C3000 TIMER2 size 0x300
0x400C4000 TIMER3 size 0x300
0x400C5000 SSP1 size 0x300
0x400C6000 QEI size 0xFFF — Product name title=UM10430 Chapter title=LPC18xx Quadrature Encoder Interface (QEI) Modification date=1/18/2011 Major revision=0 Minor revision=7
0x400C7000 GIMA size 0xFFF — Product name title=UM10503 Chapter title=LPC43xx Global Input Multiplexer Array (GIMA) Modification date=10/7/2011 Major revision=0 Minor revision=3
0x400E0000 I2C1 size 0xFFF
0x400E1000 DAC size 0xFFF — Product name title=UM10430 Chapter title=LPC18xx DAC Modification date=1/18/2011 Major revision=0 Minor revision=7
0x400E2000 C_CAN0 size 0xFFF
0x400E3000 ADC0 size 0xFFF — Product name title=UM10430 Chapter title=LPC18xx 10-bit ADC0/1 Modification date=1/18/2011 Major revision=0 Minor revision=7
0x400E4000 ADC1 size 0xFFF
0x400F4000 GPIO_PORT size 0xFFFFF
0x40100000 SPI size 0xFFF — Product name title=UM10503 Chapter title=LPC43xx SPI Modification date=10/7/2011 Major revision=0 Minor revision=3
0x40101000 SGPIO size 0xFFF — Product name title=UM10503 Chapter title=LPC43xx Serial GPIO (SGPIO) Modification date=10/7/2011 Major revision=0 Minor revision=3

## Interrupts
0 DAC
2 DMA (GPDMA)
5 ETHERNET
6 SDIO (SDMMC)
7 LCD
8 USB0
9 USB1
10 SCT
11 RITIMER
12 TIMER0
13 TIMER1
14 TIMER2
15 TIMER3
16 MCPWM
17 ADC0
18 I2C0
19 I2C1
20 SPI_INT (SPI)
21 ADC1
22 SSP0
23 SSP1
24 USART0
25 UART1
26 USART2
27 USART3
28 I2S0
29 I2S1
31 SGPIO_IINT (SGPIO)
{n+32} PIN_INT{n} (GPIO_PIN_INT) (n=0..7)
40 GINT0 (GPIO_GROUP_INT0)
41 GINT1 (GPIO_GROUP_INT1)
42 EVENTROUTER
43 C_CAN1
46 ATIMER
47 RTC
49 WWDT
51 C_CAN0
52 QEI
